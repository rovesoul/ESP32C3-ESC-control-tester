## main/Kconfig.projbuild
```kconfig
menu "ESC Tester Configuration"

    config ESC_TESTER_RESERVED
        bool "Reserved"
        default n
        help
            Placeholder for future ESC tester configuration items.

endmenu
```
